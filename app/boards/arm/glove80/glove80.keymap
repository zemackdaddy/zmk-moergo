/*

 * Copyright (c) 2020 The ZMK Contributors
 *
 * SPDX-License-Identifier: MIT
 */

#include <behaviors.dtsi>
#include <dt-bindings/zmk/outputs.h>
#include <dt-bindings/zmk/keys.h>
#include <dt-bindings/zmk/rgb.h>
#include <dt-bindings/zmk/bt.h>
#include <dt-bindings/zmk/mouse.h>

// ==== MOUSE-KEY <section begins> ====
#define ZMK_MOUSE_DEFAULT_MOVE_VAL 1250
#define ZMK_MOUSE_DEFAULT_SCRL_VAL 100

#include <dt-bindings/zmk/mouse.h>

&mmv {
  acceleration-exponent = <1>;      // 1
  time-to-max-speed-ms = <400>;    // 40
  delay-ms = <0>;                   // 0
};

&msc {
  acceleration-exponent = <1>;      // 0
  time-to-max-speed-ms = <500>;    // 40
  delay-ms = <0>;                   // 10
};
// ==== MOUSE-KEY <section ends> =====

#define HYPER LC(LS(LG(LALT)))

	&mt {
		tapping-term-ms = <210>;
		flavor = "tap-preferred";
		quick_tap_ms = <200>;
	};

	&lt { quick_tap_ms = <200>; };

/ {
	// layers
	#define DEFAULT 0
	#define LOWER 1
	#define NAV 2
	#define MAGIC 3
	#define MOUSE 4
	#define SLOW_MOUSE 5
	#define BLANK 6
	#define FACTORY_TEST 7

	#define MO_TOG(layer) &mo_tog layer layer   // Macro to apply momentary-layer-on-hold/toggle-layer-on-tap to a specific layer
	#define MEH(key) LS(LC(LA(key)))
	#define HYP(key) LS(LC(LA(LG(key))))

	#define U_MOUSE_MOVE_MAX 1400                     /* <--- New max speed setting (default: 600) */
	#define U_MOUSE_MOVE_SLOW_MAX 300                     /* <--- New max speed setting (default: 600) */

	#undef MOVE_UP
	#undef MOVE_UP_SLOW
	#undef MOVE_DOWN
	#undef MOVE_DOWN_SLOW
	#undef MOVE_LEFT
	#undef MOVE_LEFT_SLOW
	#undef MOVE_RIGHT
	#undef MOVE_RIGHT_SLOW
	#define MOVE_UP MOVE_Y(-U_MOUSE_MOVE_MAX)
	#define MOVE_UP_SLOW MOVE_Y(-U_MOUSE_MOVE_SLOW_MAX)
	#define MOVE_DOWN MOVE_Y(U_MOUSE_MOVE_MAX)
	#define MOVE_DOWN_SLOW MOVE_Y(U_MOUSE_MOVE_SLOW_MAX)
	#define MOVE_LEFT MOVE_X(-U_MOUSE_MOVE_MAX)
	#define MOVE_LEFT_SLOW MOVE_X(-U_MOUSE_MOVE_SLOW_MAX)
	#define MOVE_RIGHT MOVE_X(U_MOUSE_MOVE_MAX)
	#define MOVE_RIGHT_SLOW MOVE_X(U_MOUSE_MOVE_SLOW_MAX)

	#define U_MOUSE_SCRL_MAX 25                    /* <--- New max speed setting (default: 10) */
	#define U_MOUSE_SCRL_MAX_SLOW 10

	#undef SCRL_UP
	#undef SCRL_UP_SLOW
	#undef SCRL_DOWN
	#undef SCRL_DOWN_SLOW
	#undef SCRL_LEFT
	#undef SCRL_LEFT_SLOW
	#undef SCRL_RIGHT
	#undef SCRL_RIGHT_SLOW
	#define SCRL_UP SCRL_Y(U_MOUSE_SCRL_MAX)
	#define SCRL_UP_SLOW SCRL_Y(U_MOUSE_SCRL_MAX_SLOW)
	#define SCRL_DOWN SCRL_Y(-U_MOUSE_SCRL_MAX)
	#define SCRL_DOWN_SLOW SCRL_Y(-U_MOUSE_SCRL_MAX_SLOW)
	#define SCRL_LEFT SCRL_X(-U_MOUSE_SCRL_MAX)
	#define SCRL_LEFT_SLOW SCRL_X(-U_MOUSE_SCRL_MAX_SLOW)
	#define SCRL_RIGHT SCRL_X(U_MOUSE_SCRL_MAX)
	#define SCRL_RIGHT_SLOW SCRL_X(U_MOUSE_SCRL_MAX_SLOW)

  // TYPING_STREAK_TERM defines how long you need to wait (milliseconds)
  // after typing before you can use home row mods again.  It prevents
  // unintended activation of home row mods when you're actively typing.
  //
  #define TYPING_STREAK_TERM 160 // global-quick-tap-ms
  //
  // KEY_REPEATING_TERM defines how much time you have left (milliseconds)
  // after tapping a key to hold it again in order to make it auto-repeat.
  //
  #define KEY_REPEATING_TERM 300 // "tap then hold" for key auto-repeat
  //
  // HOMEY_TAPPING_TERM defines how long you need to hold (milliseconds)
  // home row mod keys in order to send their modifiers to the computer
  // (i.e. "register" them) for mod-click mouse usage (e.g. Ctrl-Click).
  //
  // NOTE: the "balanced" flavor of ZMK hold-tap for home row mods already
  // provides instant modifier activation for keyboard-only usage, so this
  // setting is meant for combined keyboard/mouse usage such as mod-clicks.
  //
  #define HOMEY_TAPPING_TERM 175 // TAPPING_TERM + ALLOW_CROSSOVER_AFTER
  //
  // INDEX_TAPPING_TERM defines how long you need to hold (milliseconds)
  // index finger keys in order to send their modifiers to the computer
  // (i.e. "register" them) for mod-click mouse usage (e.g. Shift-Click).
  //
  // NOTE: the "tap-preferred" flavor of ZMK hold-tap for index finger keys
  // lowers the risk of accidental modifier activation since typing streaks
  // aren't enforced on them so as not to hinder their speed and dexterity.
  //
  #define INDEX_TAPPING_TERM 180
  //
  // THUMB_TAPPING_TERM defines how long you need to hold (milliseconds)
  // a thumb key to activate a layer.  Shorter holds are treated as taps.
  //
  #define THUMB_TAPPING_TERM 200
  //
  // Glove80 key positions index for positional hold-tap
  // https://discord.com/channels/877392805654306816/937645688244826154/1066713913351221248
  // https://media.discordapp.net/attachments/937645688244826154/1066713913133121556/image.png
  //
  // |------------------------|------------------------|
  // | LEFT_HAND_KEYS         |        RIGHT_HAND_KEYS |
  // |                        |                        |
  // |  0  1  2  3  4         |          5  6  7  8  9 |
  // | 10 11 12 13 14 15      |      16 17 18 19 20 21 |
  // | 22 23 24 25 26 27      |      28 29 30 31 32 33 |
  // | 34 35 36 37 38 39      |      40 41 42 43 44 45 |
  // | 46 47 48 49 50 51      |      58 59 60 61 62 63 |
  // | 64 65 66 67 68         |         75 76 77 78 79 |
  // |                69 52   |   57 74                |
  // |                 70 53  |  56 73                 |
  // |                  71 54 | 55 72                  |
  // |------------------------|------------------------|
  //
  #define LEFT_HAND_KEYS      \
        0  1  2  3  4         \
        10 11 12 13 14 15      \
        22 23 24 25 26 27      \
        34 35 36 37 38 39      \
        46 47 48 49 50 51      \
        64 65 66 67 68
  #define RIGHT_HAND_KEYS     \
                                          5  6  7  8  9 \
                                      16 17 18 19 20 21 \
                                      28 29 30 31 32 33 \
                                      40 41 42 43 44 45 \
                                      58 59 60 61 62 63 \
                                        75 76 77 78 79
  #define THUMB_KEYS          \
                      69 52       57 74                \
                        70 53     56 73                 \
                        71 54   55 72
};

	/*****************************************************************************/

																		/* Helper Macros */

		/*****************************************************************************/

		#define STRINGIFY(x) #x
		/* Create a ZMK behavior without having to specify the name three times */
		#define ZMK_BEHAVIOR(NAME, ...) \
    behaviors { \
        NAME: NAME { \
            label = STRINGIFY(ZB_ ## NAME); \
            __VA_ARGS__ \
        }; \
    };

		 /*****************************************************************************/

																		 /* Timers */

		 /*****************************************************************************/

		 /* How long Sticky Keys stay pressed */
		 #define STICKY_KEY_RELEASE_AFTER_MS 600

		 /* How long to hold for Autoshift */
		 #define AUTOSHIFT_TAPPING_TERM_MS 200

		 /* How long to hold to activate home row mods for same side or mouse usage */
		 #define HOME_ROW_MODS_TAPPING_TERM_MS 300

		 /* Cool down after typing before home row mods can be used */
		 #define HOME_ROW_MODS_QUICK_TAP_MS 250

		 /* How long thumb keys can be held before rolls send the higher layer key */
		 #define THUMBS_TAPPING_TERM_MS 200

		 /* How quickly to double tap thumb keys to hold down the key */
		 #define THUMBS_QUICK_TAP_MS 250

		 /* How long until the selection continuation mode times out */
		 #define CONTINUE_SELECTION_TIMEOUT 60000

		 /* How quickly combo keys must be pressed together */
		 #define COMBO_TIMEOUT_MS 25


		/*****************************************************************************/

																		/* Thumb Layer Keys */

		/*****************************************************************************/

		/* Balanced thumb layer tap behavior using timers configured above */
		#define THUMB_LAYER_TAP(NAME, TAP_BINDING) \
				ZMK_BEHAVIOR(NAME, \
						compatible = "zmk,behavior-hold-tap"; \
						#binding-cells = <2>; \
						flavor = "balanced"; \
						tapping-term-ms = <THUMBS_TAPPING_TERM_MS>;  /* Rolls send tap key */ \
						quick-tap-ms = <THUMBS_QUICK_TAP_MS>;  /* Double tap to repeat */ \
						bindings = <&mo>, <TAP_BINDING>; \
				)

		/* Thumb layer tap behavior for Editing, Number, Media and Function layers */
	/{ THUMB_LAYER_TAP(t_lt, &kp) };

		/*****************************************************************************/

																		/* Autoshift */

		/*****************************************************************************/

		/* Autoshift behavior using timers configured above */
		#define AUTOSHIFT(NAME, HOLD, TAP) \
				ZMK_BEHAVIOR(NAME, \
						compatible = "zmk,behavior-hold-tap"; \
						#binding-cells = <2>; \
						tapping-term-ms = <AUTOSHIFT_TAPPING_TERM_MS>;  /* Hold for shift */ \
						flavor = "tap-preferred"; \
						bindings = <HOLD>, <TAP>; \
				)

		/* Main Autoshift behavior */
		/ { AUTOSHIFT(as, &kp, &kp) };

		/* Autoshift behavior for one handed Number layer usage */
		/ {	AUTOSHIFT(tog_sl, &tog, &sl) };

 / {   behaviors {
  //
  // Home row mod-tap keys for all except index fingers
  //
  homey_left: miryoku_home_row_mods_left_hand {
      compatible = "zmk,behavior-hold-tap";
      label = "HOME_ROW_MODS_LEFT_HAND";
      flavor = "balanced";
      hold-trigger-key-positions = <RIGHT_HAND_KEYS THUMB_KEYS>;
      hold-trigger-on-release; // wait for other home row mods
      tapping-term-ms = <HOMEY_TAPPING_TERM>;
      quick-tap-ms = <TYPING_STREAK_TERM>;
      global-quick-tap; // with typing streak
      #binding-cells = <2>;
      bindings = <&kp>, <&kp>;
  };
  homey_right: miryoku_home_row_mods_right_hand {
      compatible = "zmk,behavior-hold-tap";
      label = "HOME_ROW_MODS_RIGHT_HAND";
      flavor = "balanced";
      hold-trigger-key-positions = <LEFT_HAND_KEYS THUMB_KEYS>;
      hold-trigger-on-release; // wait for other home row mods
      tapping-term-ms = <HOMEY_TAPPING_TERM>;
      quick-tap-ms = <TYPING_STREAK_TERM>;
      global-quick-tap; // with typing streak
      #binding-cells = <2>;
      bindings = <&kp>, <&kp>;
  };
  //
  // Special home row mod-tap keys for the index fingers
  //
  index_left: miryoku_home_row_mods_left_index_shift {
      compatible = "zmk,behavior-hold-tap";
      label = "HOME_ROW_MODS_LEFT_INDEX_SHIFT";
      flavor = "tap-preferred";
      hold-trigger-key-positions = <RIGHT_HAND_KEYS THUMB_KEYS>;
      //hold-trigger-on-release; // don't wait for other mods
      tapping-term-ms = <INDEX_TAPPING_TERM>;
      quick-tap-ms = <KEY_REPEATING_TERM>; // enable repeat
      //global-quick-tap; // no typing streak
      #binding-cells = <2>;
      bindings = <&kp>, <&kp>;
  };
  index_right: miryoku_home_row_mods_right_index_shift {
      compatible = "zmk,behavior-hold-tap";
      label = "HOME_ROW_MODS_RIGHT_INDEX_SHIFT";
      flavor = "tap-preferred";
      hold-trigger-key-positions = <LEFT_HAND_KEYS THUMB_KEYS>;
      //hold-trigger-on-release; // don't wait for other mods
      tapping-term-ms = <INDEX_TAPPING_TERM>;
      quick-tap-ms = <KEY_REPEATING_TERM>; // enable repeat
      //global-quick-tap; // no typing streak
      #binding-cells = <2>;
      bindings = <&kp>, <&kp>;
  };
  //
  // Thumb cluster hold-tap keys for Miryoku layers
  //
  thumb: miryoku_thumb_layer {
      compatible = "zmk,behavior-hold-tap";
      label = "MIRYOKU_LAYER_TAP_WITH_REPEAT";
      flavor = "balanced";
      tapping-term-ms = <THUMB_TAPPING_TERM>;
      quick-tap-ms = <KEY_REPEATING_TERM>; // enable repeat
      //global-quick-tap; // no typing streak
      #binding-cells = <2>;
      bindings = <&mo>, <&kp>;
  };

        // For the "layer" key, it'd nice to be able to use it as either a shift or a toggle.
        // Configure it as a tap dance, so the first tap (or hold) is a &mo and the second tap is a &to
        layer_td: tap_dance_0 {
            compatible = "zmk,behavior-tap-dance";
            #binding-cells = <0>;
            tapping-term-ms = <200>;
            bindings = <&mo LOWER>, <&to LOWER>;
        };

        magic: magic_hold_tap {
            compatible = "zmk,behavior-hold-tap";
            #binding-cells = <2>;
            flavor = "tap-preferred";
            tapping-term-ms = <200>;
            bindings = <&mo>, <&rgb_ug_status_macro>;
        };

        mouse_td: tap_dance_1 {
            compatible = "zmk,behavior-tap-dance";
            label = "MOUSE_TAP_DANCE";
            #binding-cells = <0>;
            tapping-term-ms = <200>;
            bindings = <&kp DEL>, <&tog MOUSE>;
        };

        mouse_hold: mouse_hold_tap {
            compatible = "zmk,behavior-hold-tap";
            label = "MOUSE_HOLD_TAP";
            #binding-cells = <2>;
            flavor = "tap-preferred";
            tapping-term-ms = <200>;
            bindings = <&mo>, <&mouse_td>;
        };
    };
};
/ {
    macros {
        rgb_ug_status_macro: rgb_ug_status_macro_0 {
            compatible = "zmk,behavior-macro";
            #binding-cells = <0>;
            bindings
                = <&rgb_ug RGB_STATUS>;
        };

        bt_0: bt_profile_macro_0 {
            compatible = "zmk,behavior-macro";
            #binding-cells = <0>;
            bindings
                = <&out OUT_BLE>,
                  <&bt BT_SEL 0>;
        };

        bt_1: bt_profile_macro_1 {
            compatible = "zmk,behavior-macro";
            #binding-cells = <0>;
            bindings
                = <&out OUT_BLE>,
                  <&bt BT_SEL 1>;
        };

        bt_2: bt_profile_macro_2 {
            compatible = "zmk,behavior-macro";
            #binding-cells = <0>;
            bindings
                = <&out OUT_BLE>,
                  <&bt BT_SEL 2>;
        };

        bt_3: bt_profile_macro_3 {
            compatible = "zmk,behavior-macro";
            #binding-cells = <0>;
            bindings
                = <&out OUT_BLE>,
                  <&bt BT_SEL 3>;
        };

        switchapps: switchapps {
            compatible = "zmk,behavior-macro";
            label = "SWITCHAPPS";
            #binding-cells = <0>;
            wait-ms = <40>;
            tap-ms = <40>;
            bindings =
                <&macro_press>,
                <&kp LCMD>,
                <&macro_tap>,
                <&kp TAB>,
                <&macro_pause_for_release>,
                <&macro_release>,
                <&kp LCMD>;
        };
    };
};
/ {
    keymap {
        compatible = "zmk,keymap";

        default_layer {
            // ---------------------------------------------------------------------------------------------------------------------------------
            // |  F1   |  F2 |  F3 |  F4  |  F5  |                                                               |  F6   |  F7   |  F8  |   F9  |  F10 |
            // |  =    |  1  |  2  |  3   |  4   |  5   |                                                 |  6   |   7   |   8   |  9   |   0   |   -  |
            // |  TAB  |  Q  |  W  |  E   |  R   |  T   |                                                 |  Y   |   U   |   I   |  O   |   P   |   \  |
            // |  ESC  |  A  |  S  |  D   |  F   |  G   |                                                 |  H   |   J   |   K   |  L   |   ;   |   '  |
            // |   `   |  Z  |  X  |  C   |  V   |  B   | LSHFT | LCTRL | LOWER | | LGUI  | RCTRL | RSHFT |  N   |   M   |   ,   |  .   |   /   | PGUP |
            // | MAGIC | HOME| END | LEFT | RIGHT|      | BSPC  | DEL   | LALT  | | RALT  | RET   | SPACE |      |  UP   | DOWN  |  [   |   ]   | PGDN |

            bindings = <
            &magic MAGIC 0    &kp F2   &kp F3      &kp F4      &kp F5                                                                                         &kp F6  &kp F7      &kp F8      &kp F9      &kp F10
            &kp GRAVE      &kp N1   &kp N2      &kp N3      &kp N4      &kp N5                                                                     &kp N6  &kp N7  &kp N8      &kp N9      &kp N0      &kp MINUS
            &kp TAB        &kp SQT    &kp COMMA       &homey_left LALT DOT       &kp P       &kp Y                                                                      &kp F   &kp G   &kp C       &kp R       &kp L       &kp FSLH
            &t_lt MOUSE ESC        &homey_left LALT A   &homey_left LCTRL O     &homey_left LGUI E       &index_left LSHFT U   &kp I             &kp D   &index_right RSHFT H   &homey_right RGUI T   &homey_right RCTRL N  &homey_right RALT S    &kp MINUS
            &kp PG_UP      &kp SEMI    &kp Q       &kp J       &homey_left LCTRL K       &homey_left LG(SPACE) X   &homey_left LG(LC(FSLH)) TAB     &kp LCTRL   &layer_td  &kp LGUI  &kp RCTRL &kp RSHFT &kp B   &homey_right RCTRL M   &kp W   &kp V     &kp Z    &kp EQUAL
            &kp PG_DN &kp HOME &kp END     &kp LEFT    &kp RIGHT   &t_lt LOWER BSPC    &mouse_hold MOUSE 0 &kp LALT   &kp RALT  &kp RET   &t_lt NAV SPACE     &kp UP  &kp DOWN    &kp LBKT    &kp RBKT    &kp BSLH
            >;
        };

        lower_layer {
            bindings = <
            &kp C_BRI_DN      &kp C_BRI_UP        &kp C_PREV      &kp C_NEXT      &kp C_PP                                                                                                           &kp C_MUTE   &kp C_VOL_DN &kp C_VOL_UP  &none           &kp PAUSE_BREAK
            &kp F1         &kp F2   &kp F3      &kp F4      &kp F5     &kp F6                                                                              &kp F7      &kp F8      &kp F9      &kp F10 &kp F11 &kp F12
            &trans            &none               &kp LC(RS(TAB))  &kp LG(T) &kp LC(TAB) &kp END                                                                               &kp PG_UP     &kp HOME    &kp UP    &kp END     &kp PG_DN    &kp SLCK
            &trans            &none               &kp LG(LBKT)        &kp DOWN        &kp LG(RBKT)       &kp PG_UP                                                                             &kp PG_DN    &kp LEFT    &kp DOWN    &kp RIGHT     &kp RIGHT     &none
            &trans            &kp K_CMENU         &trans       &kp LG(W)       &kp F12         &kp PG_DN       &trans      &trans      &to DEFAULT &trans      &trans      &trans    &kp COMMA    &kp LC(LS(LEFT))    &kp LS(DOWN)    &kp LS(UP) &kp LC(LS(RIGHT))    &trans
            &trans            &kp CAPS            &kp INS         &trans &trans  &trans      &trans      &trans      &trans      &trans      &trans                 &kp RA(RC(LEFT)) &kp RA(RC(RIGHT)) &kp KP_DOT    &kp KP_ENTER    &trans
            >;
        };

        nav_layer {
            bindings = <
            &kp C_BRI_DN      &kp C_BRI_UP        &kp C_PREV      &kp C_NEXT      &kp C_PP                                                                                                           &kp C_MUTE   &kp C_VOL_DN &kp C_VOL_UP  &none           &kp PAUSE_BREAK
            &kp F1         &kp F2   &kp F3      &kp F4      &kp F5     &kp F6                                                                              &kp F7      &kp F8      &kp F9      &kp F10 &kp F11 &kp F12
            &trans            &none               &kp LC(RS(TAB))  &kp LG(T) &kp LC(TAB) &kp END                                                                               &kp PG_UP     &kp HOME    &kp UP    &kp END     &kp PG_DN    &kp SLCK
            &trans            &none               &kp LEFT        &kp DOWN        &kp LSHFT       &kp PG_UP                                                                             &kp PG_DN    &kp LEFT    &kp DOWN    &kp RIGHT     &kp RIGHT     &none
            &trans            &kp K_CMENU         &trans       &kp LG(W)       &kp F12         &kp PG_DN       &trans      &trans      &to DEFAULT &trans      &trans      &trans    &kp COMMA    &kp KP_N1    &kp KP_N2    &kp KP_N3     &kp KP_ENTER    &trans
            &trans            &kp CAPS            &kp INS         &trans &trans  &trans      &trans      &trans      &trans      &trans      &trans                 &kp RG(RC(LEFT)) &kp RG(RC(RIGHT)) &kp KP_DOT    &kp KP_ENTER    &trans
            >;
        };

        magic_layer {
            bindings = <
            &bt BT_CLR        &none               &none           &none           &none                                                                                                           &none      &none      &none      &none      &bt BT_CLR_ALL
            &none             &none               &none           &none           &none           &none                                                                                &none      &none      &none      &none      &none      &none
            &none             &rgb_ug RGB_SPI     &rgb_ug RGB_SAI &rgb_ug RGB_HUI &rgb_ug RGB_BRI &rgb_ug RGB_TOG                                                                      &none      &none      &none      &none      &none      &none
            &bootloader       &rgb_ug RGB_SPD     &rgb_ug RGB_SAD &rgb_ug RGB_HUD &rgb_ug RGB_BRD &rgb_ug RGB_EFF                                                                      &none      &none      &none      &none      &none      &bootloader
            &sys_reset        &none               &none           &none           &none           &none           &bt_2     &bt_3     &none            &none     &none     &none       &none      &none      &none      &none      &none      &sys_reset
            &none             &none               &none           &none           &none                           &bt_0     &bt_1     &out OUT_USB     &none     &none     &none                  &none      &none      &none      &none      &to FACTORY_TEST
            >;
				};

        mouse_layer {
            bindings = <
 &trans  &trans  &trans  &trans  &trans                                                                  &trans  &trans  &trans  &trans  &trans
 &trans  &trans  &trans  &trans  &trans  &trans                                                  &kp LA(LC(LS(P)))  &trans  &trans  &trans  &trans  &trans
 &trans  &trans  &trans  &trans  &trans  &trans                                                  &msc SCRL_UP  &msc SCRL_LEFT  &mmv MOVE_UP  &msc SCRL_RIGHT  &trans  &trans
 &trans  &trans  &trans  &mkp RCLK  &mkp LCLK  &trans                                                  &msc SCRL_DOWN  &mmv MOVE_LEFT  &mmv MOVE_DOWN  &mmv MOVE_RIGHT  &trans  &trans
 &trans  &trans  &trans  &trans  &trans   &trans &trans  &trans  &trans  &trans  &trans  &kp ESC  &trans  &kp LC(LA(LS(M)))  &trans  &trans  &trans  &trans
 &trans  &trans  &trans  &trans  &mo SLOW_MOUSE          &trans   &tog 0  &trans  &trans  &mkp RCLK  &mkp LCLK          &trans  &trans  &trans  &trans  &trans
            >;
        };

        slowmouse_layer {
            bindings = <
 &trans  &trans  &trans  &trans  &trans                                                                  &trans  &trans  &trans  &trans  &trans
 &trans  &trans  &trans  &trans  &trans  &trans                                                  &trans  &trans  &trans  &trans  &trans  &trans
 &trans  &trans  &trans  &trans  &trans  &trans                                                  &msc SCRL_UP_SLOW  &msc SCRL_LEFT_SLOW  &mmv MOVE_UP_SLOW  &msc SCRL_RIGHT_SLOW  &trans  &trans
 &trans  &trans  &trans  &trans  &trans  &trans                                                  &msc SCRL_DOWN_SLOW  &mmv MOVE_LEFT_SLOW  &mmv MOVE_DOWN_SLOW  &mmv MOVE_RIGHT_SLOW  &trans  &trans
 &trans  &trans  &trans  &trans  &trans  &trans  &trans  &trans  &trans  &trans  &trans  &trans  &trans  &trans  &trans  &trans  &trans  &trans
 &trans  &trans  &trans  &trans  &trans          &trans  &trans  &trans  &trans  &trans  &trans          &trans  &trans  &trans  &trans  &trans
            >;
        };

        blank_layer {
            bindings = <
 &trans  &trans  &trans  &trans  &trans                                                                  &trans  &trans  &trans  &trans  &trans
 &trans  &trans  &trans  &trans  &trans  &trans                                                  &trans  &trans  &trans  &trans  &trans  &trans
 &trans  &trans  &trans  &trans  &trans  &trans                                                  &trans  &trans  &trans  &trans  &trans  &trans
 &trans  &trans  &trans  &trans  &trans  &trans                                                  &trans  &trans  &trans  &trans  &trans  &trans
 &trans  &trans  &trans  &trans  &trans  &trans  &trans  &trans  &trans  &trans  &trans  &trans  &trans  &trans  &trans  &trans  &trans  &trans
 &trans  &trans  &trans  &trans  &trans          &trans  &trans  &trans  &trans  &trans  &trans          &trans  &trans  &trans  &trans  &trans
            >;
        };

        factory_test_layer {
            bindings = <
            &kp N0   &kp N6   &kp N2   &kp N8   &kp N4                                                                              &kp N4   &kp N8   &kp N2   &kp N6   &kp N0
            &kp N1   &kp N7   &kp N3   &kp N9   &kp N5   &kp N0                                                            &kp N0   &kp N5   &kp N9   &kp N3   &kp N7   &kp N1
            &kp N2   &kp N8   &kp N4   &kp N0   &kp N6   &kp N1                                                            &kp N1   &kp N6   &kp N0   &kp N4   &kp N8   &kp N2
            &kp N3   &kp N9   &kp N5   &kp N1   &kp N7   &kp N2                                                            &kp N2   &kp N7   &kp N1   &kp N5   &kp N9   &kp N3
            &kp N4   &kp N0   &kp N6   &kp N2   &kp N8   &kp N3   &kp N4   &kp N5   &kp N6      &kp N6   &kp N5   &kp N4   &kp N3   &kp N8   &kp N2   &kp N6   &kp N0   &kp N4
            &kp N5   &kp N1   &kp N7   &kp N3   &kp N9            &kp N7   &kp N8   &kp N9      &kp N9   &kp N8   &kp N7            &kp N9   &kp N3   &kp N7   &kp N1   &kp N5
            >;
        };
    };
};
